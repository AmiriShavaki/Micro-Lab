; Mahdi Amiri Shavaki
; 98522148

.include "m32def.inc"
.ORG	0
		RJMP	START
.ORG	OC1Aaddr
		RJMP	ROUTINE
.ORG	OC0addr
		RJMP	ROUTINE2

		;initialize stack pointers
		;------------------------
START:	LDI		R16,HIGH(RAMEND)
		OUT		SPH,R16
		LDI		R16,LOW(RAMEND)
		OUT		SPL,R16


		;initialize ports
		;------------------------
		LDI		R16,0xFF
		OUT		DDRB,R16		;PORTB as output
		OUT		DDRC,R16		;PORTC as output
		OUT		DDRD,R16		;PORTD as output
		OUT		PORTA,R16		;Enabling Pullup Resistor on PORTA 
		LDI		R16,0x00
		OUT		DDRA,R16		;PORTA as input

		;initialize timers
		;------------------------
		;timer0
		LDI		R16,0x0C ; 0 00 1 100 (CTC clk/256)
		OUT		TCCR0,R16	
		LDI		R16,0x00 ; 0
		OUT		TCNT0,R16			
		LDI		R16,0x63 
		OUT		OCR0,R16	
		;timer1
		LDI		R16,0x00 ; 0
		OUT		TCCR1A,R16
		LDI		R16,0x0C ; CTC clk/256
		OUT		TCCR1B,R16	
		;7A12 = 31250 in decimal	
		LDI		R16,0x7A
		OUT		OCR1AH,R16	
		LDI		R16,0x12
		OUT		OCR1AL,R16	
		LDI		R16,0x12
		OUT		TIMSK,R16 ;	OCIE0 and OCIE1A enabled
		SEI
		
		;initialize registers
		LDI		R24,01		;LED	
		LDI		R20,0		;yekan
		LDI		R21,0		;dahgan
		LDI		R22,0		;sadgan
		LDI		R23,0		;hezargan
		LDI		R30,0		;first digit to display is yekan
		RJMP	MAIN_LOOP

INIT0:	LDI		R20,0
		LDI		R21,0
		LDI		R22,0
		LDI		R23,0
		RJMP	CONT3

INIT9:	LDI		R20,9
		LDI		R21,9
		LDI		R22,9
		LDI		R23,9
		RJMP	CONT3

MAIN_LOOP:
		;send LEDs output to PORT B
		OUT		PORTB,R24				
		RJMP	DISP

DISP:   CLI

		CPI		R30,1
		BRSH	CONT4
		LDI		R16,0b11110111	;displaying Yekan
		OUT		PORTD,R16
		MOV		R16,R20
		CALL	CONVERT
		OUT		PORTC,R16
		RJMP	CONT7

CONT4:	CPI		R30,2
		BRSH	CONT5

		LDI		R16,0b11111011	;displaying Dahgan
		OUT		PORTD,R16
		MOV		R16,R21
		CALL	CONVERT
		OUT		PORTC,R16
		RJMP	CONT7

CONT5:	CPI		R30,3
		BRSH	CONT6

		LDI		R16,0b11111101	;displaying Sadgan
		OUT		PORTD,R16
		MOV		R16,R22
		CALL	CONVERT
		OUT		PORTC,R16
		RJMP	CONT7

CONT6:	LDI		R16,0b11111110	;displaying Hezargan
		OUT		PORTD,R16
		MOV		R16,R23
		CALL	CONVERT
		OUT		PORTC,R16

CONT7:	SEI
		RJMP	MAIN_LOOP

CONVERT:				;converts a digit to 7seg code 
		CPI		R16,0
		BRNE	C1
		LDI		R16,0x3F
		RET
C1:		CPI		R16,1
		BRNE	C2
		LDI		R16,0x06
		RET
C2:		CPI		R16,2
		BRNE	C3
		LDI		R16,0x5B
		RET
C3:		CPI		R16,3
		BRNE	C4
		LDI		R16,0x4F
		RET
C4:		CPI		R16,4
		BRNE	C5
		LDI		R16,0x66
		RET
C5:		CPI		R16,5
		BRNE	C6
		LDI		R16,0x6D
		RET
C6:		CPI		R16,6
		BRNE	C7
		LDI		R16,0x7D
		RET
C7:		CPI		R16,7
		BRNE	C8
		LDI		R16,0x07
		RET
C8:		CPI		R16,8
		BRNE	C9
		LDI		R16,0x7F
		RET
C9:		CPI		R16,9
		BRNE	C10
		LDI		R16,0x6F
C10:	RET

INCREMENT:
		CPI		R20,9
		BRLO	INC1
		CPI		R21,9
		BRLO	INC2
		CPI		R22,9
		BRLO	INC3
		CPI		R23,9
		BRLO	INC4
		RJMP	INIT0

DECREMENT:
		CPI		R20,1
		BRSH	DEC1
		CPI		R21,1
		BRSH	DEC2
		CPI		R22,1
		BRSH	DEC3
		CPI		R23,1
		BRSH	DEC4
		RJMP	INIT9

INC1:
		INC		R20
		RJMP	CONT3

DEC1:
		DEC		R20
		RJMP	CONT3

INC2:
		LDI		R20,0
		INC		R21
		RJMP	CONT3

DEC2:
		LDI		R20,9
		DEC		R21
		RJMP	CONT3

INC3:
		LDI		R20,0
		LDI		R21,0
		INC		R22
		RJMP	CONT3

DEC3:
		LDI		R20,9
		LDI		R21,9
		DEC		R22
		RJMP	CONT3

INC4:
		LDI		R20,0
		LDI		R21,0
		LDI		R22,0
		INC		R23
		RJMP	CONT3

DEC4:
		LDI		R20,9
		LDI		R21,9
		LDI		R22,9
		DEC		R23
		RJMP	CONT3

ROUTINE:
		LSL		R24
		CPI		R24,0
		BRNE	CONT
		LDI		R24,1
CONT:	IN		R16,PINA 		;read portA digit0
		MOV		R17,R16			;store as R17
		ANDI	R17,0b00000001	;remove other digits
		CPI		R17,0			;detect mode
		BRNE	DECREMENT
		RJMP	INCREMENT
CONT3:	RETI

ROUTINE2:
		INC		R30
		CPI		R30,4
		BRLO	CONT2
		LDI		R30,0
CONT2:	RETI
